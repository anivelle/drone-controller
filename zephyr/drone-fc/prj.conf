## CMakeLists.txt
```
cmake_minimum_required(VERSION 3.20.0)


find_package(Zephyr REQUIRED HINTS $ENV{ZEPHYR_BASE})
project(drone-fc)

target_sources(app PRIVATE src/main.c)
target_sources(app PRIVATE src/sparkfun_icm20948/ICM_20948_C.c)
target_sources(app PRIVATE src/vl53l4cx/vl53l4cx_all.c)
target_sources(app PRIVATE src/vl53l4cx/vl53l4cx_api.c)
target_sources(app PRIVATE src/vl53l4cx/vl53l4cx_api_calibration.c)
target_sources(app PRIVATE src/vl53l4cx/vl53l4cx_api_core.c)
target_sources(app PRIVATE src/vl53l4cx/vl53l4cx_api_debug.c)
target_sources(app PRIVATE src/vl53l4cx/vl53l4cx_api_preset_modes.c)
target_sources(app PRIVATE src/vl53l4cx/vl53l4cx_class.c)
target_sources(app PRIVATE src/vl53l4cx/vl53l4cx_core.c)
target_sources(app PRIVATE src/vl53l4cx/vl53l4cx_core_support.c)
target_sources(app PRIVATE src/vl53l4cx/vl53l4cx_dmax.c)
target_sources(app PRIVATE src/vl53l4cx/vl53l4cx_hist_algos_gen3.c)
target_sources(app PRIVATE src/vl53l4cx/vl53l4cx_hist_algos_gen4.c)
target_sources(app PRIVATE src/vl53l4cx/vl53l4cx_hist_char.c)
target_sources(app PRIVATE src/vl53l4cx/vl53l4cx_hist_core.c)
target_sources(app PRIVATE src/vl53l4cx/vl53l4cx_hist_funcs.c)
target_sources(app PRIVATE src/vl53l4cx/vl53l4cx_nvm.c)
target_sources(app PRIVATE src/vl53l4cx/vl53l4cx_platform_ipp.c)
target_sources(app PRIVATE src/vl53l4cx/vl53l4cx_register_funcs.c)
target_sources(app PRIVATE src/vl53l4cx/vl53l4cx_sigma_estimate.c)
target_sources(app PRIVATE src/vl53l4cx/vl53l4cx_silicon_core.c)
target_sources(app PRIVATE src/vl53l4cx/vl53l4cx_wait.c)
target_sources(app PRIVATE src/vl53l4cx/vl53l4cx_xtalk.c)
# zephyr_compile_options(-Wno-unused-variable -Wno-comment)
```

## prj.conf
```kconfig
# USB Output config

CONFIG_SERIAL=y
CONFIG_CONSOLE=y
CONFIG_UART_CONSOLE=y
CONFIG_STDOUT_CONSOLE=y
CONFIG_UART_LINE_CTRL=y

CONFIG_USB_DEVICE_STACK_NEXT=y
CONFIG_CDC_ACM_SERIAL_INITIALIZE_AT_BOOT=y
CONFIG_CDC_ACM_SERIAL_PID=0x0004
CONFIG_CDC_ACM_SERIAL_PRODUCT_STRING="USBD console sample"

CONFIG_GPIO=y
CONFIG_I2C=y
# CONFIG_LOG=y
# CONFIG_MULTI_LEVEL_INTERRUPTS=y
CONFIG_DYNAMIC_INTERRUPTS=y
CONFIG_GEN_ISR_TABLES=y
# CONFIG_I2C_LOG_LEVEL_DBG=y
# CONFIG_I2C_DUMP_MESSAGES=y
# CONFIG_CPP=y
# CONFIG_ARDUINO_API=y
CONFIG_CBPRINTF_FP_SUPPORT=y
CONFIG_NEWLIB_LIBC=y
CONFIG_NEWLIB_LIBC_NANO=y
CONFIG_NEWLIB_LIBC_FLOAT_PRINTF=y
CONFIG_NEWLIB_LIBC_MIN_REQUIRED_HEAP_SIZE=4096
CONFIG_RING_BUFFER=y
```

## boards/arduino_nano_33_ble.overlay
```dts
/* #include <zephyr/drivers/gpio.h> */
/* / { */
/* 	int0: int_0 { */
/* 		compatible = "interrupts"; */
/* 		gpios = <&gpio0 4 GPIO_ACTIVE_HIGH>; */
/* 	}; */
/* }; */
```

## dts/bindings/interrupts.yaml
```yaml
description: GPIO pin to act as an IMU interrupt

compatible: "interrupts"

properties:
  gpios:
    type: phandle-array
    required: true
    description: |
      The GPIO connected to the interrupt IMU.
```

## src/main.cpp
```c
#include <zephyr/kernel.h>
#include <Arduino.h>
#include <Wire.h>
#include "icm20948/icm20948.h"
#include "vl53lx/vl53lx_class.h"
#include <zephyr/usb/usb_device.h>
#include <zephyr/usb/usbd.h>
#include <zephyr/drivers/uart.h>
#include <zephyr/drivers/i2c.h>

VL53LX sensor_vl53lx_sat(&Wire, D15);

int main(void) {

    if (usb_enable(NULL))
        return 0;

    uint32_t dtr = 0;
    const struct device *const dev = DEVICE_DT_GET(DT_CHOSEN(zephyr_console));
    while (!dtr) {
        uart_line_ctrl_get(dev, UART_LINE_CTRL_DTR, &dtr);
        /* Give CPU resources to low priority threads. */
        k_sleep(K_MSEC(100));
    }

    Wire.begin();
    // Configure VL53LX satellite component.
    sensor_vl53lx_sat.begin();

    // Switch off VL53LX satellite component.
    sensor_vl53lx_sat.VL53LX_Off();

    // Initialize VL53LX satellite component.
    sensor_vl53lx_sat.InitSensor(0x12);

    // Start Measurements
    sensor_vl53lx_sat.VL53LX_StartMeasurement();

    while (1) {
        VL53LX_MultiRangingData_t MultiRangingData;
        VL53LX_MultiRangingData_t *pMultiRangingData = &MultiRangingData;
        uint8_t NewDataReady = 0;
        int no_of_object_found = 0, j;
        char report[64];
        int status;

        do {
            status =
                sensor_vl53lx_sat.VL53LX_GetMeasurementDataReady(&NewDataReady);
        } while (!NewDataReady);

        if ((!status) && (NewDataReady != 0)) {
            status =
                sensor_vl53lx_sat.VL53LX_GetMultiRangingData(pMultiRangingData);
            no_of_object_found = pMultiRangingData->NumberOfObjectsFound;
            snprintf(report, sizeof(report),
                     "VL53LX Satellite: Count=%d, #Objs=%1d ",
                     pMultiRangingData->StreamCount, no_of_object_found);
            printk("%s", report);
            for (j = 0; j < no_of_object_found; j++) {
                if (j != 0)
                    printk("\r\n                               ");
                printk("status=");
                printk("%u", pMultiRangingData->RangeData[j].RangeStatus);
                printk(", D=");
                printk("%u", pMultiRangingData->RangeData[j].RangeMilliMeter);
                printk("mm");
                printk(", Signal=");
                printk("%f",
                       pMultiRangingData->RangeData[j].SignalRateRtnMegaCps /
                           65536.0);
                printk(" Mcps, Ambient=");
                printk("%f",
                       pMultiRangingData->RangeData[j].AmbientRateRtnMegaCps /
                           65536.0);
                printk(" Mcps");
            }
            printk("\n");
            if (status == 0) {
                status = sensor_vl53lx_sat
                             .VL53LX_ClearInterruptAndStartMeasurement();
            }
        }
    }
    return 0;
}
```

## src/main_old.c
```c
#include <zephyr/kernel.h>
// #include <stdio.h>
// #include <zephyr/usb/usb_device.h>
// #include <zephyr/usb/usbd.h>
#include <zephyr/drivers/uart.h>
#include <zephyr/sys/printk.h>
#include "icm20948/icm20948.h"

#define DEFAULT_STACK 512

/*
 *  ICM20948 Necessary Components
 */
BUILD_ASSERT(DT_NODE_HAS_COMPAT(DT_CHOSEN(zephyr_console), zephyr_cdc_acm_uart),
             "Console device is not ACM CDC UART device");
// Data buffer
uint8_t icm20948_fifo_buffer[FIFO_SIZE];

// void icm20948_isr(const void *unused) {
//     // TODO: Check if right pin was activated here
//     k_sem_give(&icm20948_ready);
// }

K_THREAD_STACK_DEFINE(gyro_stack_area, DEFAULT_STACK);
struct k_thread gyro_thread_data;
//
extern void read_icm20948_data(void *dev, void *unused2, void *unused3) {
    const struct device *const i2c_dev = (const struct device *const)dev;
    while (1) {
        printk("Semaphore reset\n");
        uint8_t data_ready = 0;
        icm20948_readregister(i2c_dev, ICM20948_DATA_RDY_STATUS, &data_ready);
        // if (!k_sem_take(&icm20948_ready, K_FOREVER)) {
        if (data_ready) {
            uint16_t bytes_ready = 0;
            icm20948_get_fifo_count(i2c_dev, &bytes_ready);
            printk("FIFO count: %d\n", bytes_ready);
            icm20948_read_fifo(i2c_dev, icm20948_fifo_buffer, bytes_ready);
            // uint8_t dummy;
            // icm20948_readregister(i2c_dev, ICM20948_INT_STATUS, &dummy);
        }
    }
}

int main(void) {

    // if (usb_enable(NULL))
    //     return 0;

    uint32_t dtr = 0;
    const struct device *const dev = DEVICE_DT_GET(DT_CHOSEN(zephyr_console));
    while (!dtr) {
        uart_line_ctrl_get(dev, UART_LINE_CTRL_DTR, &dtr);
        /* Give CPU resources to low priority threads. */
        k_sleep(K_MSEC(100));
    }

    // Initialize I2C and set it to fast mode
    const struct device *const i2c_dev = DEVICE_DT_GET(DT_NODELABEL(i2c0));
    if (i2c_dev == NULL || !device_is_ready(i2c_dev))
        printk("Could not get I2C device");

    uint32_t dev_config = I2C_SPEED_FAST | I2C_MODE_CONTROLLER;
    i2c_configure(i2c_dev, dev_config);

    // This was just to check that I was interfacing properly
    uint8_t test;
    int err = icm20948_readregister(i2c_dev, ICM20948_WHO_AM_I, &test);
    printk("Error %d: %X\n", err, test);

    // k_sem_give(&icm20948_ready);
    // Set up the semaphore to block the thread until the interrupt occurs
    // printk("Semaphore status: %d\n", k_sem_take(&icm20948_ready, K_FOREVER));
    // Wake up the ICM20948 from sleep mode
    uint8_t pwr_mode;
    icm20948_readregister(i2c_dev, ICM20948_PWR_MGMT_1, &pwr_mode);
    pwr_mode &= ~SLEEP;
    icm20948_setregister(i2c_dev, ICM20948_PWR_MGMT_1, pwr_mode);

    icm20948_readregister(i2c_dev, ICM20948_PWR_MGMT_1, &pwr_mode);
    printk("Power mode: %X\n", pwr_mode);

    // Enable the DMP and FIFO on the IMU
    icm20948_userconfig(i2c_dev, DMP_EN | FIFO_EN);
    icm20948_readregister(i2c_dev, ICM20948_USER_CTRL, &test);
    icm20948_userconfig(i2c_dev, DMP_RST);
    icm20948_setregister(i2c_dev, ICM20948_FIFO_RST, 0x1F);
    icm20948_setregister(i2c_dev, ICM20948_FIFO_RST, 0x00);
    printk("User config: %X\n", test);

    // printk("User config done\n");
    while (1) {
        // printk("Semaphore reset\n");
        uint8_t data_ready = 0;
        icm20948_readregister(i2c_dev, ICM20948_DATA_RDY_STATUS, &data_ready);
        // if (!k_sem_take(&icm20948_ready, K_FOREVER)) {
        if (data_ready) {
            uint16_t bytes_ready = 0;
            icm20948_get_fifo_count(i2c_dev, &bytes_ready);
            printk("FIFO count: %u\n", bytes_ready);
            if (bytes_ready > 0) 
              icm20948_read_fifo(i2c_dev, icm20948_fifo_buffer, bytes_ready);
            // uint8_t dummy;
            // icm20948_readregister(i2c_dev, ICM20948_INT_STATUS, &dummy);
        }
        k_sleep(K_MSEC(10));
    }

    // Enables DMP interrupts
    // icm20948_set_int(i2c_dev, DMP_INT1_EN);
    // char buf;
    // icm20948_readregister(i2c_dev, ICM20948_INT_STATUS, &buf);

    // printk("Interrupt registers: %X\n", buf);

    // Create and start a thread that constantly tries to read from the IMU
    // k_tid_t icm20948_get_gyro = k_thread_create(
    //     &gyro_thread_data, gyro_stack_area,
    //     K_THREAD_STACK_SIZEOF(gyro_stack_area), &read_icm20948_data,
    //     (void *)&i2c_dev, NULL, NULL, 7, 0, K_NO_WAIT);
    // k_thread_join(icm20948_get_gyro, K_FOREVER);
    return 0;
}
```
